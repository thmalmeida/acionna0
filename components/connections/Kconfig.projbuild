## components/connections/Kconfig.projbuild
```kconfig
menu "Connections configuration"

    config BT_NAME 
        string "Bluetooth Name"
        default "bt_00"
        help
			Bluetooth label name to connect

	config WIFI_SSID
		string "WiFi SSID"
		default "0yd017"
			help
				SSID (network name) to connect to.

	config WIFI_PASSWORD
		string "WiFi Password"
		default "praticamente"
		help
			WiFi password (WPA or WPA2) for the example to use.
			Can be left blank if the network has no security set.

	config H2E_IDENTIFIER
		string "Password H2E identifier"
		default ""
		help
			nothing to tell

	config IP_END_FORCE
		bool "Force ip end"
		default 1
		help
			Force ip end byte to device.

	if IP_END_FORCE
		config IP_END
			int "WiFi ip end"
			default "29"
			help
				when static ip choose define ip end on lan network
	endif

	config WS_SERVER_PORT
		int "Websocket local server port connection"
		default "9000"
		help
			websocket server port

	config WS_CLIENT_URI
		string "websocket server URI"
		default "ws://192.168.1.10"
		help
			websocket server URI point

	config WS_CLIENT_PORT
		int "Websocket remote server port connection"
		default "8999"
		help
			websocket server port to connect

endmenu
```

## components/ota/Kconfig.projbuild
```kconfig
menu "OTA configuration"

	config FIRMWARE_UPGRADE_URL
		string "Firmware upgrade URL"
		default "http://192.168.1.8:80/acionna/acionna0.bin"
		help
			Full link of firmware upgrade image

	config OTA_RECV_TIMEOUT
		int "OTA timeout [ms]"
		default 5000
		help
			OTA timeout if not find the url link.
			Maximum time for reception.

	config SKIP_COMMON_NAME_CHECK
		bool "Skip server certificate CN fieldcheck"
		default n
		help
			This allows you to skip the validation of OTA server certificate CN field.

	config SKIP_VERSION_CHECK
		bool "Skip firmware version check"
		default n
		help
			This allows you to skip the firmware version check.

endmenu
```

## main/Kconfig.projbuild
```kconfig
menu "Acionna Configuration"

	config WELL_SUPPORT
        bool "Enable well support"
        default 1
        help
            configure WELL flags and pins

    config VALVES_SUPPORT
        bool "Enable valves support"
        default 1
        help
            configure valves machine state, flags and pins

    config BT_ENABLE
        bool "Enable Bluetooth support"
        default 0
        help
            must see into Bluetooth component configuration too
endmenu
```
